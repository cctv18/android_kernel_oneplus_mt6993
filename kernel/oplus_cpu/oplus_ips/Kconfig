## kernel/oplus_cpu/oplus_ips/Kconfig
```kconfig
# SPDX-License-Identifier: GPL-2.0-only
# Copyright (C) 2018-2026 Oplus. All rights reserved.

config OPLUS_FEATURE_IPS
    tristate "IPS cpufreq governor"
    default n
    help
      A new cpufreq governor based on IPS load tracking.
```
